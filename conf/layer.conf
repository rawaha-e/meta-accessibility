## conf/layer.conf
```bitbake
BBPATH .= ":${LAYERDIR}"

BBFILES += "${LAYERDIR}/recipes-*/*/*.bb \
            ${LAYERDIR}/recipes-*/*/*.bbappend"

BBFILE_COLLECTIONS += "accessibility"
BBFILE_PATTERN_accessibility = "^${LAYERDIR}/"
BBFILE_PRIORITY_accessibility = "6"

LAYERDEPENDS_accessibility = "core"
LAYERSERIES_COMPAT_accessibility = "wrynose"
```
